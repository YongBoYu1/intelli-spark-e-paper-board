## firmware/main/Kconfig.projbuild
```kconfig
menu "Fridge Ink WiFi Config"

    config WIFI_SSID
        string "WiFi SSID"
        default ""
        help
            Home network SSID for the ESP32 to connect to.

    config WIFI_PASSWORD
        string "WiFi Password"
        default ""
        help
            Home network password.

endmenu

menu "Fridge Ink Voice Config"

    config VOICE_API_URL
        string "Voice backend base URL"
        default "http://localhost:8000"
        help
            Base URL of the voice interpret backend, e.g.
            http://192.168.1.10:8000
            Must be reachable over WiFi from the ESP32.

    config VOICE_API_TOKEN
        string "Voice backend auth token (Bearer)"
        default ""
        help
            Bearer token for the voice backend. Leave empty to disable auth.
            Must match the VOICE_API_TOKEN env var on the server.

endmenu
```
